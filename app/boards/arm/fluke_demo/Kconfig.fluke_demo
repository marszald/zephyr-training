## app/west.yml
```yaml
manifest:
  version: 1.0

  projects:
    - name: zephyr
      url: https://github.com/zephyrproject-rtos/zephyr
      revision: v4.1.0
      import:
        name-allowlist:
          - cmsis
          - hal_nxp
          - hal_nordic
        path-prefix: deps

  self:
    path: app
```
